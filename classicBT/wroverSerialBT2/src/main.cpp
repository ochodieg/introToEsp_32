#include <Arduino.h>          // necessary
#include <BluetoothSerial.h>  
#include <Wire.h>             // I2c
#include <Adafruit_GFX.h>     // graphics
#include <Adafruit_SSD1306.h> // oled

/******************************** BLUETOOTH ********************************/
BluetoothSerial phoneInput;  // bt object

/********************************** OLED **********************************/
#define SCREEN_WIDTH 128
#define SCREEN_HEIGHT 64
Adafruit_SSD1306  oled (
    SCREEN_WIDTH,
    SCREEN_HEIGHT,
    &Wire,
    -1);

/******** SERIAL COMMS FIELDS ******/
const byte numChars = 255;    // global field of type 'byte' (used to determin array length)
char receivedChars[numChars]; // array of chars where input will go
boolean newData = false;      // flag determines when we have acquired input
const String picString = "picture";// comparison variable determines an oled output

/******** ANIMATION FIELDS ********/
//oled image 1
static const uint8_t image_data_isshin1[1040] = {
    // ∙∙∙∙∙∙∙∙∙∙∙∙∙∙∙∙∙∙∙∙∙∙∙∙∙∙∙∙∙∙∙∙∙∙∙∙∙∙∙∙∙∙∙∙∙∙∙∙∙∙∙∙∙∙∙∙∙∙∙∙∙∙∙∙∙∙∙∙∙∙∙∙∙∙∙∙∙∙∙∙∙∙∙∙∙∙∙∙∙∙∙∙∙∙∙∙∙∙∙∙∙∙∙∙∙∙∙∙∙∙∙∙∙∙∙∙∙∙∙∙∙∙∙∙∙∙∙∙
    // ∙∙∙∙∙∙∙∙∙∙∙∙∙∙∙∙∙∙∙∙∙∙∙∙∙∙∙∙∙∙∙∙∙∙∙∙∙∙∙∙∙∙∙∙∙∙∙∙∙∙∙∙∙∙∙∙∙∙∙∙∙∙∙∙∙∙∙∙∙∙∙∙∙∙∙∙∙∙∙∙∙∙∙∙∙∙∙∙∙∙∙∙∙∙∙∙∙∙∙∙∙∙∙∙∙∙∙∙∙∙∙∙∙∙∙∙∙∙∙∙∙∙∙∙∙∙∙∙
    // ∙∙∙∙∙∙∙∙∙∙∙∙∙∙∙∙∙∙∙∙∙∙∙∙∙∙∙∙∙∙∙∙∙∙∙∙∙∙∙∙∙∙∙∙∙∙∙∙∙∙∙∙∙∙∙∙∙∙∙∙∙∙∙∙∙∙∙█∙∙∙∙∙∙∙∙∙∙∙∙∙∙∙∙∙∙∙∙∙∙∙∙∙∙∙∙∙∙∙∙∙∙∙∙∙∙∙∙∙∙∙∙∙∙∙∙∙∙∙∙∙∙∙∙∙∙∙∙
    // ∙∙∙∙∙∙∙∙∙∙∙∙∙∙∙∙∙∙∙∙∙∙∙∙∙∙∙∙∙∙∙∙∙∙∙∙∙∙∙∙∙∙∙∙∙∙∙∙∙∙∙∙∙∙∙∙∙∙∙█∙∙∙∙∙∙∙█∙∙∙∙∙∙∙∙∙∙∙∙∙∙∙∙∙∙∙∙∙∙∙∙∙∙∙∙∙∙∙∙∙∙∙∙∙∙∙∙∙∙∙∙∙∙∙∙∙∙∙∙∙∙∙∙∙∙∙∙
    // ∙∙∙∙∙∙∙∙∙∙∙∙∙∙∙∙∙∙∙∙∙∙∙∙∙∙∙∙∙∙∙∙∙∙∙∙∙∙∙∙∙∙∙∙∙∙∙∙∙∙∙∙∙∙∙∙∙∙∙∙∙∙∙∙∙∙∙∙∙∙∙∙∙∙∙∙∙∙∙∙∙∙∙∙∙∙∙∙∙∙∙∙∙∙∙∙∙∙∙∙∙∙∙∙∙∙∙∙∙∙∙∙∙∙∙∙∙∙∙∙∙∙∙∙∙∙∙∙
    // ∙∙∙∙∙∙∙∙∙∙∙∙∙∙∙∙∙∙∙∙∙∙∙∙∙∙∙∙∙∙∙∙∙∙∙∙∙∙∙∙∙∙∙∙∙∙∙∙∙∙∙∙∙∙∙∙∙∙∙∙∙∙∙∙∙∙∙∙∙∙∙∙∙∙∙∙∙∙∙∙∙∙∙∙∙∙∙∙∙∙∙∙∙∙∙∙∙∙∙∙∙∙∙∙∙∙∙∙∙∙∙∙∙∙∙∙∙∙∙∙∙∙∙∙∙∙∙∙
    // ∙∙∙∙∙∙∙∙∙∙∙∙∙∙∙∙∙∙∙∙∙∙∙∙∙∙∙∙∙∙∙∙∙∙∙∙∙∙∙∙∙∙∙∙∙∙∙∙∙∙∙∙∙∙∙∙∙████████∙∙∙∙∙∙∙∙∙∙∙∙∙∙∙∙∙∙∙∙∙∙∙∙∙∙∙∙∙∙∙∙∙∙∙∙∙∙∙∙∙∙∙∙∙∙∙∙∙∙∙∙∙∙∙∙∙∙∙∙∙∙∙
    // ∙∙∙∙∙∙∙∙∙∙∙∙∙∙∙∙∙∙∙∙∙∙∙∙∙∙∙∙∙∙∙∙∙∙∙∙∙∙∙∙∙∙∙∙∙∙∙∙∙∙∙∙∙∙∙∙██████████∙∙∙∙∙∙∙∙∙∙∙∙∙∙∙∙∙∙∙∙∙∙∙∙∙∙∙∙∙∙∙∙∙∙∙∙∙∙∙∙∙∙∙∙∙∙∙∙∙∙∙∙∙∙∙∙∙∙∙∙∙∙
    // ∙∙∙∙∙∙∙∙∙∙∙∙∙∙∙∙∙∙∙∙∙∙∙∙∙∙∙∙∙∙∙∙∙∙∙∙∙∙∙∙█∙∙∙∙∙∙∙∙∙∙∙∙∙█████████████∙∙∙∙∙∙∙∙∙∙∙∙∙█∙∙∙∙∙∙∙∙∙∙∙∙∙∙∙∙∙∙∙∙∙∙∙∙∙∙∙∙∙∙∙∙∙∙∙∙∙∙∙∙∙∙∙∙∙∙∙
    // ∙∙∙∙∙∙∙∙∙∙∙∙∙∙∙∙∙∙∙∙∙∙∙∙∙∙∙∙∙∙∙∙∙∙∙∙∙∙∙∙███∙∙∙∙∙∙∙∙∙∙∙██████████████∙∙∙∙∙∙∙∙∙∙∙██∙∙∙∙∙∙∙∙∙∙∙∙∙∙∙∙∙∙∙∙∙∙∙∙∙∙∙∙∙∙∙∙∙∙∙∙∙∙∙∙∙∙∙∙∙∙∙
    // ∙∙∙∙∙∙∙∙∙∙∙∙∙∙∙∙∙∙∙∙∙∙∙∙∙∙∙∙∙∙∙∙∙∙∙∙∙∙∙∙████∙∙∙∙∙∙∙∙∙███████████████∙∙∙∙∙∙∙∙∙∙███∙∙∙∙∙∙∙∙∙∙∙∙∙∙∙∙∙∙∙∙∙∙∙∙∙∙∙∙∙∙∙∙∙∙∙∙∙∙∙∙∙∙∙∙∙∙∙
    // ∙∙∙∙∙∙∙∙∙∙∙∙∙∙∙∙∙∙∙∙∙∙∙∙∙∙∙∙∙∙∙∙∙∙∙∙∙∙∙∙∙████∙∙∙∙∙∙∙∙████████████████∙∙∙∙∙∙∙∙███∙∙∙∙∙∙∙∙∙∙∙∙∙∙∙∙∙∙∙∙∙∙∙∙∙∙∙∙∙∙∙∙∙∙∙∙∙∙∙∙∙∙∙∙∙∙∙∙
    // ∙∙∙∙∙∙∙∙∙∙∙∙∙∙∙∙∙∙∙∙∙∙∙∙∙∙∙∙∙∙∙∙∙∙∙∙∙∙∙∙∙█████∙∙∙∙∙∙█████████████████∙∙∙∙∙∙█████∙∙∙∙∙∙∙∙∙∙∙∙∙∙∙∙∙∙∙∙∙∙∙∙∙∙∙∙∙∙∙∙∙∙∙∙∙∙∙∙∙∙∙∙∙∙∙∙
    // ∙∙∙∙∙∙∙∙∙∙∙∙∙∙∙∙∙∙∙∙∙∙∙∙∙∙∙∙∙∙∙∙∙∙∙∙∙∙∙∙∙∙█████∙∙∙∙∙█∙███████████████∙∙∙∙∙██████∙∙∙∙∙∙∙∙∙∙∙∙∙∙∙∙∙∙∙∙∙∙∙∙∙∙∙∙∙∙∙∙∙∙∙∙∙∙∙∙∙∙∙∙∙∙∙∙
    // ∙∙∙∙∙∙∙∙∙∙∙∙∙∙∙∙∙∙∙∙∙∙∙∙∙∙∙∙∙∙∙∙∙∙∙∙∙∙∙∙∙∙███████∙∙∙█████████████████∙∙∙∙██████∙∙∙∙∙∙∙∙∙∙∙∙∙∙∙∙∙∙∙∙∙∙∙∙∙∙∙∙∙∙∙∙∙∙∙∙∙∙∙∙∙∙∙∙∙∙∙∙∙
    // ∙∙∙∙∙∙∙∙∙∙∙∙∙∙∙∙∙∙∙∙∙∙∙∙∙∙∙∙∙∙∙∙∙∙∙∙∙∙∙∙∙∙∙██████∙∙∙█████████████████∙∙∙███████∙∙∙∙∙∙∙∙∙∙∙∙∙∙∙∙∙∙∙∙∙∙∙∙∙∙∙∙∙∙∙∙∙∙∙∙∙∙∙∙∙∙∙∙∙∙∙∙∙
    // ∙∙∙∙∙∙∙∙∙∙∙∙∙∙∙∙∙∙∙∙∙∙∙∙∙∙∙∙∙∙∙∙∙∙∙∙∙∙∙∙∙∙∙███████∙∙█████████████████∙∙███████∙∙∙∙∙∙∙∙∙∙∙∙∙∙∙∙∙∙∙∙∙∙∙∙∙∙∙∙∙∙∙∙∙∙∙∙∙∙∙∙∙∙∙∙∙∙∙∙∙∙
    // ∙∙∙∙∙∙∙∙∙∙∙∙∙∙∙∙∙∙∙∙∙∙∙∙∙∙∙∙∙∙∙∙∙∙∙∙∙∙∙∙█∙∙∙███████∙█████████████████∙███████∙∙∙█∙∙∙∙∙∙∙∙∙∙∙∙∙∙∙∙∙∙∙∙∙∙∙∙∙∙∙∙∙∙∙∙∙∙∙∙∙∙∙∙∙∙∙∙∙∙∙
    // ∙∙∙∙∙∙∙∙∙∙∙∙∙∙∙∙∙∙∙∙∙∙∙∙∙∙∙∙∙∙∙∙∙∙∙∙∙∙∙∙∙███∙██████∙█████████████████∙██████████∙∙∙∙∙∙∙∙∙∙∙∙∙∙∙∙∙∙∙∙∙∙∙∙∙∙∙∙∙∙∙∙∙∙∙∙∙∙∙∙∙∙∙∙∙∙∙∙
    // ∙∙∙∙∙∙∙∙∙∙∙∙∙∙∙∙∙∙∙∙∙∙∙∙∙∙∙∙∙∙∙∙∙∙∙∙∙∙∙∙∙████∙█████∙█████████████████∙█████∙██∙█∙∙∙∙∙∙∙∙∙∙∙∙∙∙∙∙∙∙∙∙∙∙∙∙∙∙∙∙∙∙∙∙∙∙∙∙∙∙∙∙∙∙∙∙∙∙∙∙
    // ∙∙∙∙∙∙∙∙∙∙∙∙∙∙∙∙∙∙∙∙∙∙∙∙∙∙∙∙∙∙∙∙∙∙∙∙∙∙∙∙∙█████∙████∙█████████████████∙████∙∙█∙██∙∙∙∙∙∙∙∙∙∙∙∙∙∙∙∙∙∙∙∙∙∙∙∙∙∙∙∙∙∙∙∙∙∙∙∙∙∙∙∙∙∙∙∙∙∙∙∙
    // ∙∙∙∙∙∙∙∙∙∙∙∙∙∙∙∙∙∙∙∙∙∙∙∙∙∙∙∙∙∙∙∙∙∙∙∙∙∙∙∙∙∙█████∙∙█∙∙████████∙█████████∙█∙∙█████∙∙∙∙∙∙∙∙∙∙∙∙∙∙∙∙∙∙∙∙∙∙∙∙∙∙∙∙∙∙∙∙∙∙∙∙∙∙∙∙∙∙∙∙∙∙∙∙∙
    // ∙∙∙∙∙∙∙∙∙∙∙∙∙∙∙∙∙∙∙∙∙∙∙∙∙∙∙∙∙∙∙∙∙∙∙∙∙∙∙∙∙∙██████∙∙∙███████████████████∙∙∙██████∙∙∙∙∙∙∙∙∙∙∙∙∙∙∙∙∙∙∙∙∙∙∙∙∙∙∙∙∙∙∙∙∙∙∙∙∙∙∙∙∙∙∙∙∙∙∙∙∙
    // ∙∙∙∙∙∙∙∙∙∙∙∙∙∙∙∙∙∙∙∙∙∙∙∙∙∙∙∙∙∙∙∙∙∙∙∙∙∙∙∙∙∙█████████████████████████████████████∙∙∙∙∙∙∙∙∙∙∙∙∙∙∙∙∙∙∙∙∙∙∙∙∙∙∙∙∙∙∙∙∙∙∙∙∙∙∙∙∙∙∙∙∙∙∙∙∙
    // ∙∙∙∙∙∙∙∙∙∙∙∙∙∙∙∙∙∙∙∙∙∙∙∙∙∙∙∙∙∙∙∙∙∙∙∙∙∙∙∙∙∙█████████████████████████████████████∙∙∙∙∙∙∙∙∙∙∙∙∙∙∙∙∙∙∙∙∙∙∙∙∙∙∙∙∙∙∙∙∙∙∙∙∙∙∙∙∙∙∙∙∙∙∙∙∙
    // ∙∙∙∙∙∙∙∙∙∙∙∙∙∙∙∙∙∙∙∙∙∙∙∙∙∙∙∙∙∙∙∙∙∙∙∙∙∙∙∙∙∙█████████████████████████████████████∙∙∙∙∙∙∙∙∙∙∙∙∙∙∙∙∙∙∙∙∙∙∙∙∙∙∙∙∙∙∙∙∙∙∙∙∙∙∙∙∙∙∙∙∙∙∙∙∙
    // ∙∙∙∙∙∙∙∙∙∙∙∙∙∙∙∙∙∙∙∙∙∙∙∙∙∙∙∙∙∙∙∙∙∙∙∙∙∙∙∙∙∙█∙█████████████████████████████████∙█∙∙∙∙∙∙∙∙∙∙∙∙∙∙∙∙∙∙∙∙∙∙∙∙∙∙∙∙∙∙∙∙∙∙∙∙∙∙∙∙∙∙∙∙∙∙∙∙∙
    // ∙∙███████████████████████████████████████∙█∙██████████████████████████████████∙∙∙█████████████████████████████████████████████∙∙
    // ∙∙███████████████████████████████████████∙█████████████████∙█∙█████████████████∙██████████████████████████████████████████████∙∙
    // ∙∙██∙∙∙∙∙∙∙∙∙∙∙∙∙∙∙∙∙∙∙∙∙∙∙∙∙∙∙∙∙∙∙∙∙∙∙∙∙∙██████∙█████████∙∙██∙████████████████∙∙∙∙∙∙∙∙∙∙∙∙∙∙∙∙∙∙∙∙∙∙∙∙∙∙∙∙∙∙∙∙∙∙∙∙∙∙∙∙∙∙∙∙∙∙█∙∙
    // ∙∙██∙∙∙∙∙∙∙∙∙∙∙∙∙∙∙∙∙∙∙∙∙∙∙∙∙∙∙∙∙∙∙∙∙∙∙∙∙∙∙████████████∙∙∙∙███∙∙∙∙████████████∙∙∙∙∙∙∙∙∙∙∙∙∙∙∙∙∙∙∙∙∙∙∙∙∙∙∙∙∙∙∙∙∙∙∙∙∙∙∙∙∙∙∙∙∙∙∙█∙∙
    // ∙∙██∙∙∙∙∙∙∙∙∙∙∙∙∙∙∙∙∙∙∙∙∙∙∙∙∙∙∙∙∙∙∙∙∙∙∙∙∙∙∙███████∙█████∙∙∙███∙∙∙█████∙███████∙∙∙∙∙∙∙∙∙∙∙∙∙∙∙∙∙∙∙∙∙∙∙∙∙∙∙∙∙∙∙∙∙∙∙∙∙∙∙∙∙∙∙∙∙∙∙█∙∙
    // ∙∙██∙∙∙∙∙∙∙∙∙∙∙∙∙∙∙∙∙∙∙∙∙∙∙∙∙∙∙∙∙∙∙∙∙∙∙∙∙∙∙████████∙∙∙∙∙█∙█████∙█∙∙∙∙∙∙███████∙∙∙∙∙∙∙∙∙∙∙∙∙∙∙∙∙∙∙∙∙∙∙∙∙∙∙∙∙∙∙∙∙∙∙∙∙∙∙∙∙∙∙∙∙∙∙█∙∙
    // ∙∙██∙∙∙∙∙∙∙∙∙∙∙∙∙∙∙∙∙∙∙∙∙∙∙∙∙∙∙∙∙∙∙∙∙∙∙∙∙∙∙██∙██████████∙∙█████∙∙██████████∙██∙∙∙∙∙∙∙∙∙∙∙∙∙∙∙∙∙∙∙∙∙∙∙∙∙∙∙∙∙∙∙∙∙∙∙∙∙∙∙∙∙∙∙∙∙∙∙█∙∙
    // ∙∙██∙∙∙∙∙∙∙∙∙∙∙∙∙∙∙∙∙∙∙∙∙∙∙∙∙∙∙∙∙∙∙∙∙∙∙∙∙∙█∙∙██████████∙∙∙█████∙∙∙██████████∙∙█∙∙∙∙∙∙∙∙∙∙∙∙∙∙∙∙∙∙∙∙∙∙∙∙∙∙∙∙∙∙∙∙∙∙∙∙∙∙∙∙∙∙∙∙∙∙█∙∙
    // ∙∙██∙∙∙∙∙∙∙∙∙∙∙∙∙∙∙∙∙∙∙∙∙∙∙∙∙∙∙∙∙∙∙∙∙∙∙∙∙∙∙∙∙██∙████████∙███████∙████████∙██∙∙∙∙∙∙∙∙∙∙∙∙∙∙∙∙∙∙∙∙∙∙∙∙∙∙∙∙∙∙∙∙∙∙∙∙∙∙∙∙∙∙∙∙∙∙∙∙∙█∙∙
    // ∙∙██∙∙∙∙∙∙∙∙∙∙∙∙∙∙∙∙∙∙∙∙∙∙∙∙∙∙█∙∙∙█∙∙∙∙∙∙∙∙∙∙███████████████████████████████∙∙∙∙∙∙∙∙∙∙∙∙∙∙∙∙∙∙∙∙∙∙∙∙∙∙∙∙∙∙∙∙∙∙∙∙∙∙∙∙∙∙∙∙∙∙∙∙∙█∙∙
    // ∙∙██∙∙∙∙∙∙∙∙█∙∙█∙∙∙∙∙∙∙∙∙∙∙∙∙█∙∙∙█∙∙∙∙∙∙∙∙∙∙∙████∙███∙∙████████∙█∙∙∙∙██∙████∙∙∙∙∙∙∙∙∙∙∙∙∙∙∙∙∙∙∙∙∙∙∙∙∙∙∙∙∙∙∙∙∙∙∙∙∙∙∙█∙█∙∙∙∙∙∙∙█∙∙
    // ∙∙██∙∙∙∙∙∙∙∙█∙█∙∙∙∙∙∙∙∙∙∙∙█∙∙█∙∙∙█∙∙∙∙∙∙∙∙∙∙∙█████∙██∙█████████∙████████████∙∙∙∙∙∙∙∙∙∙∙∙∙∙∙∙∙∙∙∙∙∙∙∙∙∙∙∙∙∙∙∙∙∙∙∙∙∙█∙∙█∙∙∙∙∙∙∙█∙∙
    // ∙∙██∙∙∙∙∙∙∙∙█∙█∙∙∙∙█∙∙∙∙∙∙█∙∙█∙∙█∙∙∙∙∙∙█∙∙∙∙∙∙███████∙██████████████∙∙∙█∙███∙∙█∙∙∙∙∙∙∙∙∙∙∙█∙∙∙∙∙∙∙∙∙∙∙██∙∙∙∙∙∙∙∙∙∙█∙∙∙∙∙∙∙∙∙∙█∙∙
    // ∙∙██∙∙∙∙∙∙∙∙█∙█∙∙∙∙█∙∙∙∙∙∙█∙∙███∙∙∙∙∙∙∙∙∙██∙∙∙██████∙██████∙███████∙∙███∙██∙∙█∙∙∙∙∙∙∙∙∙∙∙∙█∙∙∙∙∙∙∙∙∙∙∙∙∙∙∙∙∙██∙∙∙∙█∙█∙∙∙∙∙∙∙∙█∙∙
    // ∙∙██∙∙∙∙∙∙∙∙∙∙∙∙∙∙∙∙█∙∙∙∙████████∙∙∙∙∙∙∙∙∙∙∙∙∙███████████∙███████∙█∙███████∙∙█████∙█∙∙∙∙∙∙∙∙∙∙∙∙∙∙∙∙∙∙∙∙∙∙∙█∙∙∙∙∙∙∙∙∙∙∙∙∙∙∙∙∙█∙∙
    // ∙∙██∙∙∙∙∙∙∙∙∙∙∙∙∙∙∙∙█∙∙∙█∙∙∙█∙∙∙∙∙∙∙∙∙∙∙∙∙∙∙∙∙∙███∙███∙████∙█████████∙█∙█∙∙∙█∙∙∙∙∙∙∙∙∙∙███∙∙██∙∙∙∙∙∙∙∙∙∙∙∙█∙∙∙∙∙∙∙∙∙∙∙∙∙∙∙∙∙∙█∙∙
    // ∙∙██∙∙∙∙∙∙∙∙∙∙∙∙∙∙∙∙∙∙∙∙∙∙∙∙█∙∙∙∙∙∙∙∙∙∙∙∙∙∙∙∙∙∙███████████∙████████∙███∙█∙∙█∙∙∙∙█∙∙∙∙∙∙∙∙█∙█∙∙∙∙∙∙∙∙∙∙∙∙██∙∙∙∙∙∙∙∙∙∙∙∙∙∙∙∙∙∙∙█∙∙
    // ∙∙██∙∙∙∙∙∙∙∙∙∙∙∙∙███∙∙∙∙∙∙∙██∙∙∙∙∙∙∙█████∙█∙∙∙∙∙████████████████████∙∙∙██∙∙∙∙∙∙∙█∙∙∙∙∙∙∙∙██∙∙∙∙∙∙∙∙∙∙∙∙∙∙∙█∙∙∙∙∙∙∙∙∙∙∙∙∙∙∙∙∙∙█∙∙
    // ∙∙██∙∙∙∙∙∙∙∙∙∙∙∙∙∙∙∙█∙∙∙∙████∙∙∙∙∙∙∙∙∙∙∙∙█∙∙∙∙∙∙███████∙∙█∙███████∙█████∙∙∙∙∙███∙∙∙∙∙∙∙∙█∙∙█∙∙∙∙∙∙∙∙∙∙∙∙∙∙∙█∙∙∙∙∙∙∙∙∙∙∙∙∙∙∙∙∙█∙∙
    // ∙∙██∙∙∙∙∙∙∙∙∙∙∙∙∙∙∙∙∙∙∙∙█∙∙█∙█∙∙∙∙∙∙∙∙∙∙█∙∙∙∙∙∙∙∙∙██████∙█∙█████∙█∙∙██∙█∙∙∙∙∙∙██∙∙∙∙∙∙█∙█∙∙█∙∙∙∙∙∙∙∙∙∙∙∙∙∙██∙∙∙∙∙∙∙∙∙∙∙∙∙∙∙∙∙█∙∙
    // ∙∙██∙∙∙∙∙∙∙∙∙∙∙∙∙∙∙█∙∙██∙∙∙∙∙∙∙∙∙∙∙∙∙∙██∙∙∙∙∙∙∙∙∙∙███∙█∙██∙∙∙∙∙∙∙█████∙█∙∙∙∙∙█∙∙∙∙∙∙∙█∙∙∙∙∙∙█∙∙∙∙∙∙∙∙∙∙∙█∙∙██∙∙∙∙∙∙∙∙∙∙∙∙∙∙∙∙█∙∙
    // ∙∙██∙∙∙∙∙∙∙∙∙∙∙∙∙██∙∙∙∙∙∙∙█∙∙∙∙∙∙∙∙∙∙██∙∙∙∙∙∙∙∙∙█∙∙█∙∙█∙█∙∙∙∙∙∙∙∙█████∙∙∙∙∙██∙∙∙█∙∙∙∙∙∙█∙∙∙∙∙█∙██∙∙∙∙∙∙∙∙∙∙∙∙∙∙∙∙∙∙∙∙∙∙∙∙∙∙∙∙█∙∙
    // ∙∙██∙∙∙∙∙∙∙∙∙∙∙∙█∙██∙∙∙∙∙∙█∙∙∙∙∙∙∙∙██∙∙█∙∙∙∙█∙∙∙∙∙∙██∙██████∙██████∙██∙∙∙∙∙∙∙∙∙∙∙██∙∙∙∙█∙∙∙∙∙∙█∙∙∙∙∙∙∙█∙∙∙█∙∙∙∙∙∙∙∙∙∙∙∙∙∙∙∙∙∙█∙∙
    // ∙∙██∙∙∙∙∙∙∙∙∙∙∙█∙∙∙∙█∙∙∙∙∙∙∙∙∙∙∙∙∙∙∙∙∙∙∙∙██∙∙∙∙∙∙∙∙∙██∙∙███████████∙█∙█∙∙∙∙∙∙∙∙∙∙∙∙∙∙∙∙∙∙∙∙∙∙∙∙∙∙∙∙∙∙∙∙███∙∙∙∙∙∙∙∙∙∙∙∙∙∙∙∙∙∙∙█∙∙
    // ∙∙██∙∙∙∙∙∙∙∙∙∙█∙∙∙∙∙∙█∙∙∙∙∙∙∙∙∙∙∙∙∙∙∙∙∙∙∙∙∙∙∙∙∙∙∙∙∙∙██████████████∙██∙∙█∙∙∙∙∙∙∙∙∙∙∙∙∙∙∙∙∙∙∙∙∙∙∙∙∙∙∙∙∙∙∙∙∙∙∙∙∙∙∙∙∙∙∙∙∙∙∙∙∙∙∙∙∙█∙∙
    // ∙∙██∙∙∙∙∙∙∙∙∙∙∙∙∙∙∙∙∙∙█∙∙∙∙∙∙∙∙∙∙∙∙∙∙∙∙∙∙∙∙∙∙∙∙∙∙∙∙∙∙█∙██████∙██∙∙∙█∙∙∙∙∙∙∙∙∙∙∙∙∙∙∙∙∙∙∙∙∙∙∙∙∙∙∙∙∙∙∙∙∙∙∙∙∙∙∙∙∙∙∙∙∙∙∙∙∙∙∙∙∙∙∙∙∙█∙∙
    // ∙∙██∙∙∙∙∙∙∙∙∙∙∙∙∙∙∙∙∙∙∙█∙∙∙∙∙∙∙∙∙∙∙∙∙∙∙∙∙∙∙∙∙∙∙∙∙∙∙∙∙██████████∙████∙∙∙∙∙∙∙∙∙∙∙∙∙∙∙∙∙∙∙∙∙∙∙∙∙∙∙∙∙∙∙∙∙∙∙∙∙∙∙∙∙∙∙∙∙∙∙∙∙∙∙∙∙∙∙∙∙█∙∙
    // ∙∙██∙∙∙∙∙∙∙∙∙∙∙∙∙∙∙∙∙∙∙∙∙∙∙∙∙∙∙∙∙∙∙∙∙∙∙∙∙∙∙∙∙∙∙∙∙∙∙∙∙∙█████████████∙∙∙∙∙∙∙∙∙∙∙∙∙∙∙∙∙∙∙∙∙∙∙∙∙∙∙∙∙∙∙∙∙∙∙∙∙∙∙∙∙∙∙∙∙∙∙∙∙∙∙∙∙∙∙∙∙∙█∙∙
    // ∙∙██∙∙∙∙∙∙∙∙∙∙∙∙∙∙∙∙∙∙∙∙∙∙∙∙∙∙∙∙∙∙∙∙∙∙∙∙∙∙∙∙∙∙∙∙∙∙∙∙∙∙∙███████████∙∙∙∙∙∙∙∙∙∙∙∙∙∙∙∙∙∙∙∙∙∙∙∙∙∙∙∙∙∙∙∙∙∙∙∙∙∙∙∙∙∙∙∙∙∙∙∙∙∙∙∙∙∙∙∙∙∙∙█∙∙
    // ∙∙██∙∙∙∙∙∙∙∙∙∙∙∙∙∙∙∙∙∙∙∙∙∙∙∙∙∙∙∙∙∙∙∙∙∙∙∙∙∙∙∙∙∙∙∙∙∙∙∙∙∙∙∙∙███████∙∙∙∙∙∙∙∙∙∙∙∙∙∙∙∙∙∙∙∙∙∙∙∙∙∙∙∙∙∙∙∙∙∙∙∙∙∙∙∙∙∙∙∙∙∙∙∙∙∙∙∙∙∙∙∙∙∙∙∙∙█∙∙
    // ∙∙██∙∙∙∙∙∙∙∙∙∙∙∙∙∙∙∙∙∙∙∙∙∙∙∙∙∙∙∙∙∙∙∙∙∙∙∙∙∙∙∙∙∙∙∙∙∙∙∙∙∙∙∙∙∙∙∙∙∙∙∙∙∙∙∙∙∙∙∙∙∙∙∙∙∙∙∙∙∙∙∙∙∙∙∙∙∙∙∙∙∙∙∙∙∙∙∙∙∙∙∙∙∙∙∙∙∙∙∙∙∙∙∙∙∙∙∙∙∙∙∙∙█∙∙
    // ∙∙██∙∙∙∙∙∙∙∙∙∙∙∙∙∙∙∙∙∙∙∙∙∙∙∙∙∙∙∙∙∙∙∙∙∙∙∙∙∙∙∙∙∙∙∙∙∙∙∙∙∙∙∙██∙∙█∙█████∙∙∙∙∙∙∙∙∙∙∙∙∙∙∙∙∙∙∙∙∙∙∙∙∙∙∙∙∙∙∙∙∙∙∙∙∙∙∙∙∙∙∙∙∙∙∙∙∙∙∙∙∙∙∙∙∙██∙∙
    // ∙∙████████████████████████████████████████████████████∙██∙█∙∙∙███∙█∙██████████████████████████████████████████████████████████∙∙
    // ∙∙∙∙∙∙∙∙∙∙∙∙∙∙∙∙∙∙∙∙∙∙∙∙∙∙∙∙∙∙∙∙∙∙∙∙∙∙∙∙∙∙∙∙∙∙∙∙∙∙∙∙∙∙∙█████∙██∙██∙∙∙∙∙∙∙∙∙∙∙∙∙∙∙∙∙∙∙∙∙∙∙∙∙∙∙∙∙∙∙∙∙∙∙∙∙∙∙∙∙∙∙∙∙∙∙∙∙∙∙∙∙∙∙∙∙∙∙∙∙∙
    // ∙∙∙∙∙∙∙∙∙∙∙∙∙∙∙∙∙∙∙∙∙∙∙∙∙∙∙∙∙∙∙∙∙∙∙∙∙∙∙∙∙∙∙∙∙∙∙∙∙∙∙∙∙∙████∙█∙████∙∙∙∙∙∙∙∙∙∙∙∙∙∙∙∙∙∙∙∙∙∙∙∙∙∙∙∙∙∙∙∙∙∙∙∙∙∙∙∙∙∙∙∙∙∙∙∙∙∙∙∙∙∙∙∙∙∙∙∙∙∙∙
    // ∙∙∙∙∙∙∙∙∙∙∙∙∙∙∙∙∙∙∙∙∙∙∙∙∙∙∙∙∙∙∙∙∙∙∙∙∙∙∙∙∙∙∙∙∙∙∙∙∙∙∙∙∙∙███∙█∙∙████∙∙∙∙∙∙∙∙∙∙∙∙∙∙∙∙∙∙∙∙∙∙∙∙∙∙∙∙∙∙∙∙∙∙∙∙∙∙∙∙∙∙∙∙∙∙∙∙∙∙∙∙∙∙∙∙∙∙∙∙∙∙∙
    // ∙∙∙∙∙∙∙∙∙∙∙∙∙∙∙∙∙∙∙∙∙∙∙∙∙∙∙∙∙∙∙∙∙∙∙∙∙∙∙∙∙∙∙∙∙∙∙∙∙∙∙∙∙∙∙∙∙∙∙∙█████∙∙∙∙∙∙∙∙∙∙∙∙∙∙∙∙∙∙∙∙∙∙∙∙∙∙∙∙∙∙∙∙∙∙∙∙∙∙∙∙∙∙∙∙∙∙∙∙∙∙∙∙∙∙∙∙∙∙∙∙∙∙∙
    // ∙∙∙∙∙∙∙∙∙∙∙∙∙∙∙∙∙∙∙∙∙∙∙∙∙∙∙∙∙∙∙∙∙∙∙∙∙∙∙∙∙∙∙∙∙∙∙∙∙∙∙∙∙∙∙∙∙∙∙∙∙∙∙∙∙∙∙∙∙∙∙∙∙∙∙∙∙∙∙∙∙∙∙∙∙∙∙∙∙∙∙∙∙∙∙∙∙∙∙∙∙∙∙∙∙∙∙∙∙∙∙∙∙∙∙∙∙∙∙∙∙∙∙∙∙∙∙∙
    0x00, 0x00, 0x00, 0x00, 0x00, 0x00, 0x00, 0x00, 0x00, 0x00, 0x00, 0x00, 0x00, 0x00, 0x00, 0x00, 
    0x00, 0x00, 0x00, 0x00, 0x00, 0x00, 0x00, 0x00, 0x00, 0x00, 0x00, 0x00, 0x00, 0x00, 0x00, 0x00, 
    0x00, 0x00, 0x00, 0x00, 0x00, 0x00, 0x00, 0x00, 0x10, 0x00, 0x00, 0x00, 0x00, 0x00, 0x00, 0x00, 
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    0x00, 0x00, 0x00, 0x00, 0x00, 0x00, 0x00, 0x00, 0x00, 0x00, 0x00, 0x00, 0x00, 0x00, 0x00, 0x00
};
//oled image 2
static const uint8_t image_data_isshin2[1054] = {
    // █████████████████████████████████████████∙█████████████████████████████████████████∙∙█████████████████████████████████████████████
    // ████████████████████████████████████████∙∙∙███████████████████████████████████████∙∙∙∙████████████████████████████████████████████
    // ███████████████████████████████████████∙∙∙∙∙█████████████████████████████████████∙∙∙∙∙████████████████████████████████████████████
    // ████████████████████████████████████████∙██∙∙∙█████████████████████████████████∙∙∙██∙█████████████████████████████████████████████
    // ████████████████████████████████████████∙∙██∙∙∙███████████████████████████████∙∙∙██∙∙█████████████████████████████████████████████
    // █████████████████████████████████████████∙████∙∙∙███████∙∙∙∙∙∙∙∙∙∙∙∙∙███████∙∙∙████∙∙█████████████████████████████████████████████
    // █████████████████████████████████████████∙∙█████∙∙∙∙∙∙∙∙∙∙∙∙∙∙∙∙∙∙∙∙∙∙∙∙∙∙∙∙∙█████∙∙██████████████████████████████████████████████
    // ██████████████████████████████████████████∙∙██████∙∙∙∙∙███∙∙█████∙∙∙██∙∙∙∙∙██████∙∙███████████████████████████████████████████████
    // ███████████████████████████████████████████∙∙███████∙∙██∙∙█████████∙∙██∙∙███████∙∙████████████████████████████████████████████████
    // ███████████████████████████████████████████∙∙∙███████∙∙∙∙█████∙█████∙██∙███████∙∙∙████████████████████████████████████████████████
    // █∙∙∙∙∙∙∙∙∙∙∙∙∙∙∙∙∙∙∙∙∙∙∙∙∙∙∙∙∙∙∙∙∙∙∙∙∙∙∙∙∙∙█∙∙∙█∙∙∙∙█∙█∙████∙████∙█████∙█∙∙∙∙█∙∙∙█∙∙∙∙∙∙∙∙∙∙∙∙∙∙∙∙∙∙∙∙∙∙∙∙∙∙∙∙∙∙∙∙∙∙∙∙∙∙∙∙∙∙∙∙∙∙██
    // █████████████████████████████████████████████████████∙█∙█████∙███∙█∙███∙██████████████████████████████████████████████████████████
    // █████████████████████████████████████████████████████∙█∙███∙█∙████████∙██████████████████████████████████████████████████████████∙
    // █████████████████████████████████████████████∙∙∙∙∙∙∙∙█∙██∙██████∙████∙∙█∙∙∙∙∙█∙∙█████████████████████████████████████████████████∙
    // ███∙█████████████████████████████████████████∙∙██∙∙∙█∙∙███∙████∙█∙████∙∙∙█∙∙██∙∙█████████████████████████████████████████████∙∙██∙
    // █████████████████████████████████████████████∙∙∙∙∙∙∙∙∙∙████████████████∙∙∙∙∙∙∙∙∙██████████████████████████████████████████████∙██∙
    // ████∙███████████████████████████████████████∙∙∙∙∙∙∙∙∙█∙███████████████∙█∙∙∙∙∙∙█∙∙███████████████████████████████████████████∙█∙██∙
    // ████████████████████████████████████████████∙∙██∙∙████∙███████████████∙████∙∙██∙∙█████████████████████████████████████████████∙██∙
    // ████████████████████████████████████████████∙∙█∙∙█████∙███████████████∙█████∙∙█∙∙█████████████████████████████████████████████∙██∙
    // ███████████∙██∙█████████████████████████████∙∙█∙∙█████∙███████████████∙█████∙∙█∙∙████████████████████████████████████∙██∙█████∙██∙
    // ████████████∙██∙██████████████∙█████████∙∙██∙∙∙∙∙█████∙∙████∙████████∙∙█∙████∙∙∙∙██████∙██████████████████████████████████████∙██∙
    // █████████∙██∙██∙███∙█████∙███∙██████████████∙█∙∙∙███∙██∙███████∙█∙∙██∙███∙∙█∙∙∙∙∙███████∙██████████████∙██████████████████████∙██∙
    // █████████∙██∙████████∙███∙█∙∙███████████████∙█∙█∙████∙█∙∙████∙████∙█∙∙███∙██∙█∙∙∙████∙███████████████████████∙████████∙██∙████∙██∙
    // ████████████████████∙∙██∙██∙██∙████████∙∙∙██∙█∙█∙█∙████∙∙█∙█████████∙∙██∙∙██∙███∙∙███∙█∙█∙██████████████∙██∙∙████████∙██∙█████∙██∙
    // ███████████████████∙███████████∙███████████∙∙█∙█∙∙██∙████████████∙█∙████∙██∙∙█∙█∙∙█∙∙██████∙███████████∙██∙███████████████████∙██∙
    // █████████████████∙█████∙██∙███████∙████∙███∙∙█∙██∙███████∙∙█∙∙█████∙█∙█∙███∙██∙█∙∙███████∙█∙██████████∙██∙████████████████████∙██∙
    // ██████████████████████∙████████████∙∙∙███∙█∙∙█∙∙██∙████████∙∙███∙∙████████∙∙██∙█∙∙██∙██∙█████∙████████████████████████████████∙██∙
    // ████████████████∙██∙█████∙██████████∙██∙███∙∙∙∙∙██∙∙████████∙∙∙∙∙█████████∙██∙∙∙█∙█∙██∙███∙████████∙███████∙█∙████████████████∙██∙
    // ████████████████∙██∙█████∙████████∙████████∙∙∙█∙∙███∙∙███∙█∙██∙∙██∙∙∙███∙█∙█∙∙█∙∙∙███∙██████∙█████∙██∙█████∙██████████████████∙██∙
    // ██████████████████∙██∙∙██████████∙██∙∙█████∙∙█∙∙█∙███∙∙█∙█∙██∙∙∙██∙∙∙█∙∙███∙∙∙∙█∙∙███∙███∙██∙███████∙█∙██████∙████████████████∙██∙
    // ██████████████████████∙█∙██████∙███∙█∙█████∙∙█∙∙██∙∙∙███████∙∙∙∙████████∙█∙∙∙█∙██∙███████∙█∙██∙████∙████∙█∙███████████████████∙██∙
    // ███████████████∙████████∙█████∙████████∙∙██∙∙∙∙██∙∙∙∙∙∙∙█∙∙██∙∙∙█∙∙∙∙∙∙∙∙██∙██∙∙█∙██∙████████∙████∙██∙∙███████████████████████∙██∙
    // █████████████∙∙██∙██████████████∙████∙█████∙∙∙∙██∙∙∙∙███∙∙∙∙∙∙∙∙█∙∙∙∙∙∙█∙∙██∙█∙∙∙∙██∙█████∙∙██████████████∙███████████████████∙██∙
    // ███████████████████████████████∙██████∙∙∙∙█∙∙∙∙∙██∙∙∙∙∙∙∙∙∙∙∙∙█∙∙∙∙∙█∙∙∙∙∙∙███∙∙∙∙█∙████████████████████∙█████████████████████∙██∙
    // ████████████████∙███████████████████████████∙∙∙∙███∙∙∙∙∙∙∙∙∙∙█∙█∙∙∙∙█∙∙∙∙∙███∙∙∙∙█████████████████████████████████████████████∙██∙
    // █████████████████████∙∙∙∙∙∙█████████████████∙∙∙∙█████∙∙∙∙∙∙∙∙█∙█∙∙█∙∙∙∙∙█████∙∙∙∙█████████████████████████████████████████████∙██∙
    // █████████████████████████████████████████████∙∙∙███████████∙∙█∙█∙∙███████████∙∙∙██████████████████████████████████████████████∙██∙
    // ██████████████████████████████████████████████∙∙∙███████∙∙∙∙∙█∙█∙∙∙∙∙███████∙∙∙███████████████████████████████████████████████∙██∙
    // ███████████████████████████████████████████████∙∙█████∙∙∙∙∙∙∙∙∙∙∙∙∙∙∙∙∙█████∙∙∙███████████████████████████████████████████████∙██∙
    // ████∙██████████████████████████████████████████∙∙∙██∙∙∙∙∙█∙∙∙∙∙∙∙∙∙█∙∙∙∙∙██∙∙∙██████████████████████████████████████████████∙█∙██∙
    // ███████████████████████████████████████████████∙∙█∙████∙█∙∙█∙█∙█∙█∙∙█∙████∙█∙∙████████████████████████████████████████████████∙██∙
    // ███∙∙∙∙∙∙∙∙∙∙∙∙∙∙∙∙∙∙∙∙∙∙∙∙∙∙∙∙∙∙∙∙∙∙∙∙∙∙∙∙∙∙∙∙∙∙∙∙∙∙∙∙∙█∙∙█∙███∙██∙∙∙∙∙∙∙∙█∙∙∙∙∙∙∙∙∙∙∙∙∙∙∙∙∙∙∙∙∙∙∙∙∙∙∙∙∙∙∙∙∙∙∙∙∙∙∙∙∙∙∙∙∙∙∙∙∙∙∙██∙
    // █████████████████████████████████████████████████████∙██████∙████████████████████████████████████████████████████████████████████∙
    // ██████████████████████████████████████████████████████████∙█∙█████∙██████████████████████████████████████████████████████████████∙
    // █████████████████████████████████████████████████∙∙∙██████∙███████∙∙∙∙███∙∙∙██████████████████████████████████████████████████████
    // █████████████████████████████████████████████████∙∙██∙██∙∙█∙█████∙∙∙∙∙∙███∙∙██████████████████████████████████████████████████████
    // █████████████████████████████████████████████████∙∙███∙∙∙█∙███████∙∙∙∙∙∙██∙∙██████████████████████████████████████████████████████
    // ████████████████████████████████████████████████∙∙██∙∙∙∙∙∙∙∙██∙██∙∙∙∙∙∙∙∙██∙∙█████████████████████████████████████████████████████
    // ████████████████████████████████████████████████∙∙█∙∙█∙∙∙∙∙∙∙∙∙∙∙∙∙∙∙∙∙█∙∙█∙∙█████████████████████████████████████████████████████
    // ███████████████████████████████████████████████∙∙█∙∙∙█∙∙∙██∙∙∙∙∙∙∙██∙∙∙█∙∙∙█∙∙████████████████████████████████████████████████████
    // ███████████████████████████████████████████████∙∙∙∙█∙∙∙∙∙███∙∙∙∙∙███∙∙∙∙∙█∙∙∙∙████████████████████████████████████████████████████
    // ██████████████████████████████████████████████∙∙∙∙██∙∙█∙∙∙█∙∙∙∙∙∙∙██∙∙█∙∙███∙∙∙███████████████████████████████████████████████████
    // ██████████████████████████████████████████████∙∙█████∙█∙∙∙∙∙∙∙∙∙∙∙∙∙∙∙█∙█████∙∙∙██████████████████████████████████████████████████
    // █████████████████████████████████████████████████████∙∙∙∙∙∙∙∙∙∙∙∙∙∙∙∙∙∙∙██████████████████████████████████████████████████████████
    // █████████████████████████████████████████████████████∙∙∙∙∙█∙∙∙∙∙∙∙█∙∙∙∙∙██████████████████████████████████████████████████████████
    // ██████████████████████████████████████████████████████∙∙∙∙∙∙∙∙∙∙∙∙∙∙∙∙∙███████████████████████████████████████████████████████████
    // ██████████████████████████████████████████████████████∙∙█∙∙∙∙∙∙∙∙∙∙∙█∙∙███████████████████████████████████████████████████████████
    // ██████████████████████████████████████████████████████∙∙█████████████∙∙███████████████████████████████████████████████████████████
    // ███████████████████████████████████████████████████████∙∙███████████∙∙████████████████████████████████████████████████████████████
    // ████████████████████████████████████████████████████████∙∙████∙████∙∙█████████████████████████████████████████████████████████████
    // █████████████████████████████████████████████████████████∙∙∙∙∙∙∙∙∙∙∙██████████████████████████████████████████████████████████████
    // ███████████████████████████████████████████████████████████∙∙∙∙∙∙∙████████████████████████████████████████████████████████████████
    0xff, 0xff, 0xff, 0xff, 0xff, 0xbf, 0xff, 0xff, 0xff, 0xff, 0xe7, 0xff, 0xff, 0xff, 0xff, 0xff, 0xc0, 
    0xff, 0xff, 0xff, 0xff, 0xff, 0x1f, 0xff, 0xff, 0xff, 0xff, 0xc3, 0xff, 0xff, 0xff, 0xff, 0xff, 0xc0, 
    0xff, 0xff, 0xff, 0xff, 0xfe, 0x0f, 0xff, 0xff, 0xff, 0xff, 0x83, 0xff, 0xff, 0xff, 0xff, 0xff, 0xc0, 
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    0xff, 0xff, 0xff, 0xff, 0xff, 0xff, 0xff, 0xe0, 0x3f, 0xff, 0xff, 0xff, 0xff, 0xff, 0xff, 0xff, 0xc0
};
//adafruit animation
static const unsigned char PROGMEM logo_bmp[] =
{ B00000000, B11000000,
  B00000001, B11000000,
  B00000001, B11000000,
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  B00000000, B00110000 };
#define NUMFLAKES     10 // Number of snowflakes in the animation 
#define LOGO_HEIGHT   16 
#define LOGO_WIDTH    16
#define XPOS           0 // Indexes into the 'icons' array in function below
#define YPOS           1
#define DELTAY         2

/*************************** OTHER FIELDS *****************************/
#define led 2 // onboard led

/************************ INITIALIZE METHODS **************************/
// this is required specifically for platformio
void blinkLong();
void blinkShort();
void testAnimate(const uint8_t *bitmap, uint8_t w, uint8_t h);
void clear();
void startUp();
void isshin1();
void isshin2();
void getMsg();
void showMsg();
////////////////////////////////////////////////////////////////////////////
void recvWithEndMarker();
void showNewData();
/////////////////////////////////////////////


/************************************************************************************/
/************************************ START MAIN ************************************/
/************************************************************************************/
void setup() {
  pinMode(led, OUTPUT);   // set led as output

  /****** Begin all Comms ******/
  Serial.begin(115200);
  phoneInput.begin("lil' guy"); // give bt device a name

  /** Initialize oled object **/
  // address indicates default I2C pins?
  if(!oled.begin(SSD1306_SWITCHCAPVCC, 0x3C)){  // if oled doesnt initialize (0x3c is serial address?)
    Serial.println(F("SSD1306 allocation failure"));
    for(;;)blinkLong();
  }
  
  // give oled a moment
  delay(2000); 
  // set oled
  clear();
  oled.setTextSize(2);
  oled.setTextColor(WHITE);
  
  // confirm successful init
  startUp();
  //clear();
}




void loop() {
  // oled.clearDisplay();
  // oled.setCursor(0,0);
  // void getMsg();
  // void showMsg();
  // delay(100);

///////////////////////////////////////////////////////////////////////////////////////////
  oled.clearDisplay();
  oled.setCursor(0,0);
  recvWithEndMarker();
  showNewData();
  delay(100);
///////////////////////////////////////////////////////////////////////////////////////////

  //oled.clearDisplay();
  //clear();
  //blinkShort();

  //testAnimate(logo_bmp, LOGO_WIDTH, LOGO_HEIGHT); // Animate bitmaps
  //if(phoneInput.available()>0 && newData == false){
    //blinkShort();
  // void getMsg();
  // void showMsg();
    //}

    
}
/************************************************************************************/
/*^^^^^^^^^^^^^^^^^^^^^^^^^^^^^^^^^^^^ END MAIN ^^^^^^^^^^^^^^^^^^^^^^^^^^^^^^^^^^^^*/
/************************************************************************************/


/***************************** LED FLAG METHODS *****************************/
void blinkShort(){
   for(int i = 0; i<3;i++){
    digitalWrite(led, HIGH);
    delay(50);
    digitalWrite(led, LOW);
    delay(50);
  }
}
void blinkLong(){
  for(int i=0; i<3;i++){
    digitalWrite(led, HIGH);
    delay(500);
    digitalWrite(led, LOW);
    delay(500);
  }
}

/****************************** OLED FUNCTIONS ******************************/
// standby animation 
void testAnimate(const uint8_t *bitmap, uint8_t w, uint8_t h) {
  int8_t f, icons[NUMFLAKES][3];

  // Initialize 'snowflake' positions
  for(f=0; f< NUMFLAKES; f++) {
    icons[f][XPOS]   = random(1 - LOGO_WIDTH, oled.width());
    icons[f][YPOS]   = -LOGO_HEIGHT;
    icons[f][DELTAY] = random(1, 6);
    // Serial.print(F("x: "));
    // Serial.print(icons[f][XPOS], DEC);
    // Serial.print(F(" y: "));
    // Serial.print(icons[f][YPOS], DEC);
    // Serial.print(F(" dy: "));
    // Serial.println(icons[f][DELTAY], DEC);
  }

  for(int i =0;i<10;i++) { // Loop forever...
    oled.clearDisplay(); // Clear the display buffer
    //blinkShort();
    // Draw each snowflake:
    for(f=0; f< NUMFLAKES; f++) {
      oled.drawBitmap(icons[f][XPOS], icons[f][YPOS], bitmap, w, h, WHITE);
    }

    oled.display(); // Show the display buffer on the screen
    delay(200);        // Pause for 1/10 second

    // Then update coordinates of each flake...
    for(f=0; f< NUMFLAKES; f++) {
      icons[f][YPOS] += icons[f][DELTAY];
      // If snowflake is off the bottom of the screen...
      if (icons[f][YPOS] >= oled.height()) {
        // Reinitialize to a random position, just off the top
        icons[f][XPOS]   = random(1 - LOGO_WIDTH, oled.width());
        icons[f][YPOS]   = -LOGO_HEIGHT;
        icons[f][DELTAY] = random(1, 6);
      }
    }
  }
}
// draw 1st logo
void isshin1(){
  digitalWrite(led, HIGH);
  oled.drawBitmap(0, 0, image_data_isshin1, 128, 64, 1);
  oled.display();
  delay(5000);
  digitalWrite(led, LOW);
  clear();
}
// draw 2nd logo
void isshin2(){
  digitalWrite(led, HIGH);
  oled.drawBitmap(0, 0, image_data_isshin2, 128, 64, 1);
  oled.display();
  delay(5000);
  digitalWrite(led, LOW);
  clear();
}
// clear and reset screen
void clear(){
  oled.clearDisplay();            
  oled.setTextSize(2);
  oled.setTextColor(WHITE);
  oled.setCursor(0,0);
  oled.display();
}
// startup message
void startUp(){
  // display logo
  isshin1();
  clear();
  oled.println("SUCESS!");
  oled.display();
  // blink as redundant confirmation
  blinkShort();
  // scroll text fully 
  oled.startscrollright(0x00, 0xFF);
  // allow enough time to scoll
  delay(2000);
  oled.stopscroll();
  delay(500);

  clear();

  oled.println("Type\nSomething!");
  oled.display();
  // blink as redundant confirmation
  blinkShort();
  // scroll text fully 
  oled.startscrollright(0x00, 0xFF);
  // allow enough time to scoll
  delay(2000);
  oled.stopscroll();
  delay(500);
  clear();
}
// obtain input message
void getMsg(){
  // "global" variable of type 'byte' used as array index
  static byte ndex = 0;   // static -> no instantiation req'd
  // deliminator for end of input
  char msgEnd      = '\n';
   // letter concats to string array
  char aLetter;  

  if(phoneInput.available()>0 && newData == false){
    // reading a single char from input
    aLetter = phoneInput.read();   
    blinkShort;
    if(aLetter != msgEnd){            //if character obtained isn't deliminator
      receivedChars[ndex] = aLetter; //add grabbed character to current index in string array
      ndex++;                        //increase position
      if(ndex >= numChars){          // check if array limit reached
        ndex = numChars -1;          // if so, delete last index to keep below limit
    }
  }
  else{                            // else if index is not at array limit
    receivedChars[ndex] = '\0';    // terminate string at current index value (either last index or after last obtained char)
    ndex = 0;
    newData = true;
    }
  }
}
// show input message
void showMsg(){
  if(newData == true){  //if have input
    // create a string copy without whitespace to filter a keyword command
    String receivedString(receivedChars);
    receivedString.trim();
    
    //led confirmation blink
    blinkShort();

    //filter keyword command
    if(receivedString == "picture"){// if keyword received
      clear();                      // prep oled
      isshin1();                    // display logo
      newData = false;              // reset input flag
    }
    else{                          // if any other input
      blinkShort();                 // led notification
      clear();                      // clear oled
      oled.write(receivedChars);    // write input to output
      oled.display();               // display output
      delay(2000);                  // enough time to scroll
      oled.startscrollright(0x00, 0xFF);// scroll text
      delay(2000);                  // enough time to scroll 
      oled.stopscroll();            // end scroll
      delay(500);                   // small delay
      clear();                      // reset oled
      delay(500);
      newData = false;
    }
  }
}



////////////////////////////////////////////////////////////////////////////////////////////


void recvWithEndMarker(){
  static byte ndx =0;   //index???
  char endMarker = '\n';//deliminator
  char aLetter; // letter to add to string array

   if (phoneInput.available()>0 && newData == false){
    aLetter = phoneInput.read();  // reading single character?

    if(aLetter != endMarker){      // if new character is not the deliminator
      receivedChars[ndx] = aLetter;// add character to current index
      ndx++;                       // increase index
      if(ndx >= numChars){         // if the index has surpassed limit
        ndx = numChars -1;         // reset index to just below limit
      }
    }
    else{                         // else if index is not at limit
      receivedChars[ndx] = '\0';  // terminating string
      ndx = 0;                    // resetting index
      newData = true;             // there is something to print
    }

  }
}


void showNewData(){
  //char[255] pic = 'pcture';
  
  
  if(newData == true){
    String receivedString(receivedChars);
    //String receivedString = trim(String(receivedChars));
    receivedString.trim();
    
    //initStart(led);

    //serialMimmic.print(char(receivedChar));
    ///serialMimmic.write(btComm.read());
    ///serialMimmic.display(); 
    ///delay(1000);
    if (receivedString == "picture"){
      oled.clearDisplay();
      oled.setCursor(0,0);
      oled.drawBitmap(0, 0, image_data_isshin1, 128, 64, 1);
      oled.display();
      delay(5000);
      oled.clearDisplay();
      oled.setCursor(0,0);
      newData = false;
    }
    else{
      // if(strcmp(receivedChars, "picture")==0){
      // }
      oled.clearDisplay();
      oled.setCursor(0,0);
      ////serialMimmic.write(aWord);
      oled.write(receivedChars);
      oled.display(); 
      delay(1000);
      newData = false;
    }  
  }
}
